## platform/meta-birdycamcam/conf/distro/birdycamcam.conf
```bitbake
DISTRO = "birdycamcam"
DISTRO_NAME = "Birdy Cam Cam"
DISTRO_VERSION = "0.0.0"
DISTRO_CODENAME = "devel"

MAINTAINER = "Jean-Marie Lemetayer <jeanmarie.lemetayer@gmail.com>"

TCLIBCAPPEND = ""

INIT_MANAGER = "systemd"

DISTRO_FEATURES = " \
    acl \
    ipv4 \
    ipv6 \
    seccomp \
    systemd-resolved \
    usbhost \
    wifi \
    xattr \
    zeroconf \
"
```

## platform/meta-birdycamcam/conf/layer.conf
```bitbake
# We have a conf and classes directory, add to BBPATH
BBPATH .= ":${LAYERDIR}"

# We have recipes-* directories, add to BBFILES
BBFILES += "${LAYERDIR}/recipes-*/*/*.bb \
            ${LAYERDIR}/recipes-*/*/*.bbappend"

BBFILE_COLLECTIONS += "birdycamcam"
BBFILE_PATTERN_birdycamcam = "^${LAYERDIR}/"
BBFILE_PRIORITY_birdycamcam = "10"

LAYERDEPENDS_birdycamcam = "core swupdate"
LAYERSERIES_COMPAT_birdycamcam = "nanbield"

BBFILES_DYNAMIC += " \
    raspberrypi:${LAYERDIR}/dynamic-layers/raspberrypi/*/*/*.bb \
    raspberrypi:${LAYERDIR}/dynamic-layers/raspberrypi/*/*/*.bbappend \
"
```
